## conf/layer.conf
```bitbake
# We have a conf and classes directory, add to BBPATH
BBPATH .= ":${LAYERDIR}"

# We have recipes-* directories, add to BBFILES
BBFILES += "${LAYERDIR}/recipes-*/*/*.bb \
            ${LAYERDIR}/recipes-*/*/*.bbappend"

BBFILE_COLLECTIONS += "meta-wpe-imx6"
BBFILE_PATTERN_meta-wpe-imx6 = "^${LAYERDIR}/"
BBFILE_PRIORITY_meta-wpe-imx6 = "6"
```
